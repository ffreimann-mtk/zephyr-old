/*
 * Copyright (c) 2025 MediaTek
 *
 * SPDX-License-Identifier: Apache-2.0
 */

#include <dt-bindings/pinctrl/mt8365-pinctrl.h>
#include <zephyr/dt-bindings/pinctrl/mt8365-pinctrl.h>


&pinctrl {
	uart1_default: uart1_default {
		group1 {
			pinmux = <PINMUX_PIN_37_URXD1__FUNC_URXD1>, <PINMUX_PIN_38_UTXD1__FUNC_UTXD1>;
		};
	};
};