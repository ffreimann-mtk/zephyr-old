## boards/mediatek/genio-510-evk/Kconfig.genio_510_evk
```kconfig
# Copyright 2025 MediaTek
# SPDX-License-Identifier: Apache-2.0

config BOARD_GENIO_510_EVK
	select SOC_MT8370_A55 if BOARD_GENIO_510_EVK_MT8370_A55
```

## boards/mediatek/genio-510-evk/board.yml
```yaml
board:
  name: genio_510_evk
  full_name: GENION 510 EVK (4*Cortex-A55 and 2*Cortex-A78)
  vendor: mediatek
  socs:
  - name: mt8370
```

## boards/mediatek/i350-pumpkin/Kconfig.i350_pumpkin
```kconfig
# Copyright 2025 MediaTek
# SPDX-License-Identifier: Apache-2.0

config BOARD_I350_PUMPKIN
	select SOC_MT8365_A53 if BOARD_I350_PUMPKIN_MT8365_A53
```

## boards/mediatek/i350-pumpkin/board.yml
```yaml
board:
  name: i350_pumpkin
  full_name: i350 Pumpkin (4*Cortex-A53)
  vendor: mediatek
  socs:
  - name: mt8365
```

## boards/mediatek/i510-pumpkin/Kconfig.i510_pumpkin
```kconfig
# Copyright 2025 MediaTek
# SPDX-License-Identifier: Apache-2.0

config BOARD_I510_PUMPKIN
	select SOC_MT8370_A55 if BOARD_I510_PUMPKIN_MT8370_A55
```

## boards/mediatek/i510-pumpkin/board.yml
```yaml
board:
  name: i510_pumpkin
  full_name: i510 Pumpkin (4*Cortex-A55 and 2*Cortex-A78)
  vendor: mediatek
  socs:
  - name: mt8370
```

## boards/mediatek/mt8365/Kconfig.mt8365
```kconfig
# Copyright 2023 The ChromiumOS Authors
# SPDX-License-Identifier: Apache-2.0

config BOARD_MT8365
	select SOC_MT8365
	help
	  Board with Mediatek MT8365 Audio DSP
```

## drivers/gpio/Kconfig.mtk_gpio
```kconfig
# MediaTek GPIO configuration options
# Copyright (c) 2025, MediaTek
# SPDX-License-Identifier: Apache-2.0

config GPIO_MT8365
	bool "MediaTek MT8365 GPIO driver"
	default y
	depends on DT_HAS_MEDIATEK_MT8365_GPIO_ENABLED
	select PINCTRL
	help
	  Enable the MediaTek MT8365 GPIO driver.
```

## drivers/interrupt_controller/Kconfig.mtk_eint
```kconfig
# Copyright 2025 MediaTek
# SPDX-License-Identifier: Apache-2.0

config MTK_EINT_MT8365
	bool "MediaTek MT8365 EINT driver"
	default y
	depends on SOC_FAMILY_MTK_GENIO
	help
	  Enable the MediaTek MT8365 EINT driver.

config MTK_EINT_MT8370
	bool "MediaTek MT8370 EINT driver"
	default n
	depends on SOC_FAMILY_MTK_GENIO
	help
	  Enable the MediaTek MT8370 EINT driver.
```

## drivers/pinctrl/Kconfig.mtk_pinctrl
```kconfig
# MediaTek PINCTRL
# Copyright (c) 2025, MediaTek
# SPDX-License-Identifier: Apache-2.0

config PINCTRL_MT8365
	bool "MediaTek MT8365 PINCTRL driver"
	default y
    depends on DT_HAS_MEDIATEK_MT8365_PINCTRL_ENABLED
	help
	  Enable the MediaTek MT8365 PINCTRL driver.
```

## dts/bindings/i2s/mediatek,mt8365-i2s.yaml
```yaml
# Copyright (c) 2025 MediaTek
# SPDX-License-Identifier: Apache-2.0

description: MTK I2S node

compatible: "mediatek,mt8365-i2s"

include: [base.yaml, i2s-controller.yaml, pinctrl-device.yaml]

properties:
  reg:
    required: true

  interrupts:
    required: true
```

## dts/bindings/i2s/mediatek,mt8370-i2s.yaml
```yaml
# Copyright (c) 2025 MediaTek
# SPDX-License-Identifier: Apache-2.0

description: MTK I2S node

compatible: "mediatek,mt8370-i2s"

include: [base.yaml, pinctrl-device.yaml]

properties:
  reg:
    required: true

  interrupts:
    required: true
```

## dts/bindings/interrupt-controller/mediatek,mt8365-intc.yaml
```yaml
# Copyright 2025 MediaTek
# SPDX-License-Identifier: Apache-2.0

description: MediaTek MT8365 EINT interrupt controller

compatible: "mediatek,mt8365-eint"

include: [base.yaml]

properties:
  reg:
    required: true

  num-lines:
    type: int
    required: true
    description: Number of lines supported by the EINT interrupt controller.
```

## dts/bindings/serial/mediatek,mt8365-uart.yaml
```yaml
# Copyright 2025 MediaTek
# SPDX-License-Identifier: Apache-2.0

description: MT8365 UART

compatible: "mediatek,mt8365-uart"

include: [uart-controller.yaml, pinctrl-device.yaml]

properties:
  reg:
    required: true

  interrupts:
    required: false

  pinctrl-0:
    required: true

  pinctrl-names:
    required: true
```

## dts/bindings/serial/mediatek,mt8370-uart.yaml
```yaml
# Copyright 2025 MediaTek
# SPDX-License-Identifier: Apache-2.0

description: MT8370 UART

compatible: "mediatek,mt8370-uart"

include: [uart-controller.yaml, pinctrl-device.yaml]

properties:
  reg:
    required: true

  interrupts:
    required: false

  pinctrl-0:
    required: true

  pinctrl-names:
    required: true
```

## soc/mediatek/mt8365/a53/Kconfig
```kconfig
# Copyright 2025 MediaTek
# SPDX-License-Identifier: Apache-2.0

config SOC_MT8365_A53
	select ARM64
	select CPU_CORTEX_A53
	select ARM_ARCH_TIMER if SYS_CLOCK_EXISTS
	select SOC_PREP_HOOK

config MCUX_CORE_SUFFIX
	default "_ca53" if SOC_MT8365_A53
```

## soc/mediatek/mt8365/a53/Kconfig.soc
```kconfig
# Copyright 2025 MediaTek
# SPDX-License-Identifier: Apache-2.0

config SOC_SERIES_MT8365
	bool
	select SOC_FAMILY_MTK_GENIO

config SOC_SERIES
	default "mt8365" if SOC_SERIES_MT8365

config SOC_MT8365
	bool
	select SOC_SERIES_MT8365

config SOC_MT8365_A53
	bool
	select SOC_MT8365
	help
	  MTK MT8365 A53

config SOC_MT8365_A53
	bool
	select SOC_MT8365
	help
	  MTK MT8365 A53

config SOC
	default "mt8365" if SOC_MT8365

config SOC_PART_NUMBER_MT8365
	bool

config SOC_PART_NUMBER
	default "mt8365" if SOC_PART_NUMBER_MT8365
```

## soc/mediatek/mt8370/a55/Kconfig.soc
```kconfig
# Copyright 2025 MediaTek
# SPDX-License-Identifier: Apache-2.0

config SOC_SERIES_MT8370
	bool
	select SOC_FAMILY_MTK_GENIO

config SOC_SERIES
	default "mt8370" if SOC_SERIES_MT8370

config SOC_MT8370
	bool
	select SOC_SERIES_MT8370

config SOC_MT8370_A55
	bool
	select SOC_MT8370
	help
	  MTK MT8370 A55

config SOC_MT8370_A55
	bool
	select SOC_MT8370
	help
	  MTK MT8370 A55

config SOC
	default "mt8370" if SOC_MT8370

config SOC_PART_NUMBER_MT8370
	bool

config SOC_PART_NUMBER
	default "mt8370" if SOC_PART_NUMBER_MT8370
```
